## Documentation/devicetree/bindings/input/touchscreen/softbuttons.txt
```
General Touchscreen Softbutton Properties:

Some touchscreens extend over the display they cover and have a number
of capacative softbuttons outside of the display the cover.

Some of these softbuttons simply report touches with coordinates outside of
the normal coordinate space for touches on the display. This binding is for
describing such buttons in devicetree.

Each softkey is represented as a sub-node of the touchscreen node.

Required subnode-properties:
 - label			: Descriptive name of the key.
 - linux,code			: Keycode to emit.
 - softbutton-min-x		: X start of the area the softbutton area covers
 - softbutton-max-x		: X end of the area the softbutton area covers
 - softbutton-min-y		: Y start of the area the softbutton area covers
 - softbutton-max-y		: Y end of the area the softbutton area covers

Optional subnode-properties:
- linux,led-trigger		: String for a LED trigger for providing visual
				  feedback that the softbutton has been pressed

Example:

#include <dt-bindings/input/input.h>

&i2c2 {
	ft5406ee8: touchscreen@38 {
		compatible = "edt,edt-ft5406";
		reg = <0x38>;
		touchscreen-size-x = <1024>;
		touchscreen-size-y = <768>;

		button@0 {
			label = "Esc";
			linux,code = <KEY_ESC>;
			softbutton-min-x = <1084>;
			softbutton-max-x = <1098>;
			softbutton-min-y = <0>;
			softbutton-max-y = <49>;
		};

		button@1 {
			label = "Home";
			linux,code = <KEY_HOMEPAGE>;
			softbutton-min-x = <1084>;
			softbutton-max-x = <1098>;
			softbutton-min-y = <50>;
			softbutton-max-y = <99>;
		};

		button@2 {
			label = "Menu";
			linux,code = <KEY_MENU>;
			softbutton-min-x = <1084>;
			softbutton-max-x = <1098>;
			softbutton-min-y = <100>;
			softbutton-max-y = <149>;
		};
	};
};
```

## drivers/char/sun4i_g2d/Kconfig
```kconfig
config SUN4I_G2D
	depends on ARCH_SUN4I || ARCH_SUN7I
	tristate "SUN4I G2D"
	default y
#	depends on HAS_IOMEM
	help
```

## drivers/gpu/drm/gm12u320/Kconfig
```kconfig
config DRM_GM12U320
	tristate "Grain Media GM12U320 based mini projectors"
	depends on DRM
	depends on USB_SUPPORT
	depends on USB_ARCH_HAS_HCD
	select USB
	select FB_SYS_FILLRECT
	select FB_SYS_COPYAREA
	select FB_SYS_IMAGEBLIT
	select FB_DEFERRED_IO
	select DRM_KMS_HELPER
        select DRM_KMS_FB_HELPER
	help
	  This is a KMS driver for Grain Media GM12U320 based usb mini video
	  projectors, such as the Acer C120.
	  Say M/Y to add support for these devices via drm/kms interfaces.
```

## drivers/gpu/drm/mali400/Kconfig
```kconfig
config DRM_MALI400
	tristate "DRM Support for Mali400"
	help
	  enable Mali400 DRI driver
```
